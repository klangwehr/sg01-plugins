## epson_projector/sdkconfig.defaults
```kconfig
CONFIG_ESP_SYSTEM_MEMPROT=n
CONFIG_ESP_SYSTEM_MEMPROT_PMS_LOCK=n
CONFIG_ELF_DYNAMIC_LOAD_SHARED_OBJECT=y
CONFIG_ELF_LOADER_LIBC_SYMBOLS=n
CONFIG_ELF_LOADER_ESPIDF_SYMBOLS=n
```
